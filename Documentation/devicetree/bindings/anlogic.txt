## Documentation/devicetree/bindings/dma/anlogic_dma.txt
```
Anlogic AXI DMA engine, it does transfers between memory and AXI4 stream
target devices. It can be configured to have one channel or two channels.
If configured as two channels, one is to transmit to the device and another
is to receive from the device.

Required properties:
- compatible: Should be one of-
		"anlogic,axi-dma"
- #dma-cells: Should be <1>, see "dmas" property below
- reg: Should contain DMA registers location and length.
- anlogic,addrwidth: Should be the vdma addressing size in bits(ex: 32 bits).
- dma-channel child node: Should have at least one channel and can have up to
	two channels per device. This node specifies the properties of each
	DMA channel (see child node properties below).

Optional properties for AXI DMA:
- anlogic,sg-length-width: Should be set to the width in bits of the length
	register as configured in h/w. Takes values {8...26}. If the property
	is missing or invalid then the default value 23 is used. This is the
	maximum value that is supported by all IP versions.

Required child node properties:
- compatible:
	For AXIDMA: It should be either "anlogic,axi-dma-mm2s-channel"
	or "anlogic,axi-dma-s2mm-channel".
- interrupts: Should contain per channel DMA interrupts.
- anlogic,datawidth: Should contain the stream data width, take values
	{32,64...1024}.

Optional child node properties:
- anlogic,include-dre: Tells hardware is configured for Data
	Realignment Engine.


Example:
++++++++

axi_dma: axidma@80000000 {
	#dma-cells = <1>;
	compatible = "anlogic,axi-dma";
	interrupt-parent = <&gic>;
	interrupts = <GIC_SPI 83 IRQ_TYPE_LEVEL_HIGH>,
			<GIC_SPI 82 IRQ_TYPE_LEVEL_HIGH>;
	reg = <0x0 0x80000000 0x0 0x1000>;
	anlogic,addrwidth = <0x20>;
	anlogic,include-sg;
	dma-channel@80000000 {
		compatible = "anlogic,axi-dma-mm2s-channel";
		dma-channels = <0x1>;
		interrupts = <GIC_SPI 83 IRQ_TYPE_LEVEL_HIGH>;
		anlogic,datawidth = <0x20>;
		anlogic,device-id = <0x0>;
		anlogic,include-dre;
	};
	dma-channel@80000030 {
		compatible = "anlogic,axi-dma-s2mm-channel";
		dma-channels = <0x1>;
		interrupts = <GIC_SPI 82 IRQ_TYPE_LEVEL_HIGH>;
		anlogic,datawidth = <0x20>;
		anlogic,device-id = <0x0>;
		anlogic,include-dre;
	};
};


* DMA client

Example:
++++++++

axidmatest: axidmatest@1 {
	compatible ="anlogic,axi-dma-test";
	dmas = <&axi_dma 0>,
		<&axi_dma 1>;
	dma-names = "axidma_mm2s", "axidma_s2mm";
};
```

## Documentation/devicetree/bindings/gpio/anlogic,gpio-anlogic.yaml
```yaml
# SPDX-License-Identifier: (GPL-2.0 OR BSD-2-Clause)
%YAML 1.2
---
$id: http://devicetree.org/schemas/gpio/anlogic,gpio-anlogic.yaml#
$schema: http://devicetree.org/meta-schemas/core.yaml#

title: Anlogic AXI GPIO controller

description:
  The AXI GPIO design provides a general purpose input/output interface
  to an AXI4-Lite interface. The AXI GPIO can be configured as either
  a single or a dual-channel device. The width of each channel is
  independently configurable. The channels can be configured to
  generate an interrupt when a transition on any of their inputs occurs.

properties:
  compatible:
    enum:
      - anlogic,axi-gpio-1.00.a

  reg:
    maxItems: 1

  "#gpio-cells":
    const: 2

  interrupts:
    maxItems: 1

  gpio-controller: true

  gpio-line-names:
    description: strings describing the names of each gpio line
    minItems: 1
    maxItems: 64

  interrupt-controller: true

  "#interrupt-cells":
    const: 2

  clocks:
    maxItems: 1

  interrupt-names: true

  anlogic,all-inputs:
    $ref: /schemas/types.yaml#/definitions/uint32
    description: This option sets this GPIO channel1 bits in input mode.

  anlogic,all-inputs-2:
    $ref: /schemas/types.yaml#/definitions/uint32
    description: This option sets this GPIO channel2 bits in input mode.

  anlogic,all-outputs:
    $ref: /schemas/types.yaml#/definitions/uint32
    description: This option sets this GPIO channel1 bits in output mode.

  anlogic,all-outputs-2:
    $ref: /schemas/types.yaml#/definitions/uint32
    description: This option sets this GPIO channel2 bits in output mode.

  anlogic,dout-default:
    $ref: /schemas/types.yaml#/definitions/uint32
    description: Sets the default value of all the enabled bits of
                 channel1.
    default: 0

  anlogic,dout-default-2:
    $ref: /schemas/types.yaml#/definitions/uint32
    description: Sets the default value of all the enabled bits of
                 channel2.
    default: 0

  anlogic,gpio-width:
    $ref: /schemas/types.yaml#/definitions/uint32
    description: The value defines the bit width of the GPIO channel1.
    minimum: 1
    maximum: 32
    default: 32

  anlogic,gpio2-width:
    $ref: /schemas/types.yaml#/definitions/uint32
    description: The value defines the bit width of the GPIO channel2.
    minimum: 1
    maximum: 32
    default: 32

  anlogic,interrupt-present:
    $ref: /schemas/types.yaml#/definitions/uint32
    description: This parameter enables interrupt control logic
                 and interrupt registers in GPIO module.
    minimum: 0
    maximum: 1
    default: 0

  anlogic,is-dual:
    $ref: /schemas/types.yaml#/definitions/uint32
    description: This parameter enables a second GPIO channel (GPIO2).
    minimum: 0
    maximum: 1
    default: 0

  anlogic,tri-default:
    $ref: /schemas/types.yaml#/definitions/uint32
    description: This value configures the input or output mode
                 of each bit of GPIO channel1.

  anlogic,tri-default-2:
    $ref: /schemas/types.yaml#/definitions/uint32
    description: This value configures the input or output mode
                 of each bit of GPIO channel2.

required:
  - reg
  - compatible
  - gpio-controller
  - "#gpio-cells"

unevaluatedProperties: false

examples:
  - |
    #include <dt-bindings/interrupt-controller/arm-gic.h>

        gpio@80000000 {
            compatible = "anlogic,axi-gpio-1.00.a";
            reg = <0x0 0x80000000 0x0 0x10000>;
            interrupts = <GIC_SPI 82 IRQ_TYPE_LEVEL_HIGH>;
            #gpio-cells = <2>;
            #interrupt-cells = <0x2>;
            gpio-controller;
            interrupt-controller;
            anlogic,all-inputs = <0x0>;
            anlogic,all-inputs-2 = <0x0>;
            anlogic,all-outputs = <0x0>;
            anlogic,all-outputs-2 = <0x0>;
            anlogic,dout-default = <0x0>;
            anlogic,dout-default-2 = <0x0>;
            anlogic,gpio-width = <0x20>;
            anlogic,gpio2-width = <0x20>;
            anlogic,interrupt-present = <0x1>;
            anlogic,is-dual = <0x1>;
            anlogic,tri-default = <0xFFFFFFFF>;
            anlogic,tri-default-2 = <0xFFFFFFFF>;
        };

...
```

## Documentation/devicetree/bindings/gpio/gpio-anlogic.txt
```
Anlogic AXI GPIO controller

Dual channel GPIO controller with configurable number of pins
(from 1 to 32 per channel). Every pin can be configured as
input/output/tristate. Both channels share the same global IRQ but
local interrupts can be enabled on channel basis.

Required properties:
- compatible : Should be "anlogic,axi-gpio-1.00.a"
- reg : Address and length of the register set for the device
- #gpio-cells : Should be two. The first cell is the pin number and the
  second cell is used to specify optional parameters (currently unused).
- gpio-controller : Marks the device node as a GPIO controller.

Optional properties:
- interrupts : Interrupt mapping for GPIO IRQ.
- anlogic,all-inputs : if n-th bit is setup, GPIO-n is input
- anlogic,dout-default : if n-th bit is 1, GPIO-n default value is 1
- anlogic,gpio-width : gpio width
- anlogic,tri-default : if n-th bit is 1, GPIO-n is in tristate mode
- anlogic,is-dual : if 1, controller also uses the second channel
- anlogic,all-inputs-2 : as above but for the second channel
- anlogic,dout-default-2 : as above but the second channel
- anlogic,gpio2-width : as above but for the second channel
- anlogic,tri-default-2 : as above but for the second channel


Example:
gpio: gpio@80000000 {
	#gpio-cells = <2>;
	compatible = "anlogic,axi-gpio-1.00.a";
	gpio-controller ;
	interrupts = <GIC_SPI 82 IRQ_TYPE_LEVEL_HIGH>;
	reg = <0x0 0x80000000 0x0 0x10000>;
	anlogic,all-inputs = <0x0>;
	anlogic,all-inputs-2 = <0x0>;
	anlogic,dout-default = <0x0>;
	anlogic,dout-default-2 = <0x0>;
	anlogic,gpio-width = <0x2>;
	anlogic,gpio2-width = <0x2>;
	anlogic,interrupt-present = <0x1>;
	anlogic,is-dual = <0x1>;
	anlogic,tri-default = <0xffffffff>;
	anlogic,tri-default-2 = <0xffffffff>;
} ;
```

## Documentation/devicetree/bindings/i2c/anlogic-axi-i2c-controller.yaml
```yaml
# SPDX-License-Identifier: (GPL-2.0 OR BSD-2-Clause)
%YAML 1.2
---
$id: "http://devicetree.org/schemas/i2c/anlogic-axi-i2c-controller#"
$schema: "http://devicetree.org/meta-schemas/core.yaml#"

title: anlogic IIC controller

maintainers:
  - naiyuan.que@anlogic.com

allOf:
  - $ref: /schemas/i2c/i2c-controller.yaml#

properties:
  compatible:
    const: anlogic-axi-i2c-controller

  reg:
    maxItems: 1

  interrupts:
    maxItems: 1

  clocks:
    minItems: 1

  clock-name:
    const: pclk
    description: |
      Input clock name.

required:
  - compatible
  - reg
  - interrupts
  - clocks

unevaluatedProperties: false

examples:
  - |
    axi_i2c: axi_i2c@80000000 {
        compatible = "anlogic-axi-i2c-controller";
        interrupts = <GIC_SPI 82 IRQ_TYPE_LEVEL_HIGH>;
        reg = <0 0x80000000 0 0x1000>;
        #address-cells = <1>;
        #size-cells = <0>;
        clocks = <&IIC_CLK>;
        clock-names = "IIC_CLK";
        status = "okay";
    };
```

## Documentation/devicetree/bindings/interrupt-controller/anlogic_axi_intc.txt
```
Anlogic axi intc bindings

Required properties:
- compatible: should be "anlogic,axi-intc-1.00.a"
- reg: physical base address of the controller and length of memory mapped region.
- interrupt-controller: Interrupt controller
- interrupt-cells: The interrupt controller requires two parameters, the interrupt number and the trigger mode
- interrupt-parent: Connected to gic
- interrupts: Interrupt specifier for the controllers interrupt.
- anlogic,num-intr-inputs: How many input interrupts are there in intc in total
- anlogic,kind-of-intr: The triggering mode of all input interrupts on intc

Example:
	axi_intc0: interrupt-controller@80000000 {
		compatible = "anlogic,axi-intc-1.00.a";
		reg = <0x0 0x80000000 0x0 0x10000>;
		interrupt-controller;
		#interrupt-cells = <2>;
		interrupt-parent = <&gic>;
		interrupts = <GIC_SPI 82 IRQ_TYPE_LEVEL_HIGH>;
		anlogic,num-intr-inputs = <6>;
		anlogic,kind-of-intr = <0x0>;
		status = "disabled";
	};
```

## Documentation/devicetree/bindings/net/can/anlogic_axi_canfd.txt
```
Anlogic axi-canfd  bindings

Required properties:
- compatible: should be "anlogic,axi-canfd"
- reg: physical base address of the controller and length of memory mapped region.
- interrupts: Interrupt specifier for the controllers interrupt.
- clocks: frequency for logic of controller and frequency for canfd IO
- bus-type: 0: AXI-lite, 1: APB
- tx-buffer-num: numbers of tx mailboxs
- rx-mode: 0 for sequential, 1 for mailbox
- rx-enable-fifo_1: 0: rx fifo-1 is disabled, 1: enabled
- rx-fifo-0-depth: depth of rx fifo-0
- rx-fifo-1-depth: depth of rx fifo-1
- rx-buffer-num: numbers of rx mailboxs

Example:

	axi_canfd_clk: AXI_CANFD_CLK {
		#clock-cells = <0>;
		compatible = "fixed-clock";
		clock-frequency = <30000000>;
		clock-output-names = "AXI_CANFD_CLK";
	};

	axi_canfd_bus_clk: AXI_CANFD_BUS_CLK {
		#clock-cells = <0>;
		compatible = "fixed-clock";
		clock-frequency = <132000000>;
		clock-output-names = "AXI_CANFD_BUS_CLK";
	};

	axi_canfd0: canfd@80000000 {
		compatible = "anlogic,axi-canfd";
		interrupts = <GIC_SPI 82 IRQ_TYPE_LEVEL_HIGH>;
		reg = <0x0 0x80000000 0 0x10000>;
		#address-cells = <1>;
		#size-cells = <0>;
		status = "okay";

		clocks = <&axi_canfd_clk>, <&axi_canfd_bus_clk>;
		clock-names = "can_clk", "bus_clk";
		bus-type = <0x0>;
		tx-buffer-num = <0x20>;
		rx-mode = <0x0>;
		rx-enable-fifo_1 = <0x1>;
		rx-fifo-0-depth = <0x40>;
		rx-fifo-1-depth = <0x40>;
		rx-buffer-num = <0x30>;
	};
```

## Documentation/devicetree/bindings/pinctrl/anlogic,dr1x-pinctrl.txt
```
* Anlogic DR1X Pin Controller

Please refer to pinctrl-bindings.txt in this directory for the common binding part and usage.

Required properties:
- compatible: Must be "anlogic,pinctrl-dr1x".
- reg: The register address of pin controller device.
- mux: Defines the multiplexing configuration of each pin or group of pins.
- conf: Specifies the configuration settings for the pins.

Optional properties:
- function: A string containing the name of the function. Possible values are:
  "qspi0", "i2c0", "i2c1", "can0", "can1", "smc0", "uart0", "uart1", "gpio", "swdt0", "ttc0","ttc1",
  "spi0", "spi1", "sdio0", "sdio1", "ethernet0", "ethernet1", "mdio0", "mdio1", "usb0", "usb1".
- bias-pull-down: Pull down on pin.
- bias-pull-up: Pull up on pin.
- bias-high-impedance: Pull down and Pull up all enabled.
- pull-ohm: Supported values: 25000 (25KΩ) and 10000 (10KΩ).
- slew-rate: Slew rate of the pin. Possible values: <FAST>, <MEDIUM>, <SLOW>.

Example:
pin_controller: pinctrl@f8803000 {
	compatible = "anlogic,pinctrl-dr1x";
	reg = <0x0 0xf8803000 0 0x1000>;

	/* QSPI0 Configuration */
	pinctrl_qspi0_default: qspi0-default {
		mux {
			function = "qspi0";
			groups = "qspi0_0_grp";
		};

		conf {
			groups = "qspi0_0_grp";
			bias-pull-up;
			pull-ohm = <OHM_10K>;
			slew-rate = <FAST>;
		};
	};

	/* I2C0 Configuration */
	pinctrl_i2c0_default: i2c0-default {
		mux {
			function = "i2c0";
			groups = "i2c0_10_grp";
		};

		conf {
			groups = "i2c0_10_grp";
			bias-pull-up;
			pull-ohm = <OHM_25K>;
			slew-rate = <SLOW>;
		};
	};
};

&qspi0 {
	pinctrl-names = "default";
	pinctrl-0 = <&pinctrl_qspi0_default>;
};

&i2c0 {
	pinctrl-names = "default";
	pinctrl-0 = <&pinctrl_i2c0_default>;
};
```

## Documentation/devicetree/bindings/remoteproc/anlogic,dragon_remoteproc.txt
```
Anlogic remoteproc bindings

Required properties:
- compatible: should be "anlogic,dragon_remoteproc"
- memory-region: phandle to the reserved memory node to be associated
                 with the remoteproc device. The reserved memory node
                 can be a CMA memory node.
- anlogic,no-openamp: if specified, the firmware should not using openamp
Remoteproc is a framework that allows the ARM0 host processor(s) to load firmware into ARM1 cores, start the ARM1 cores, stop the ARM1 cores, and configure resources that the ARM1 might need during their execution.

Example:
	&soc {
		remoteproc0: remoteproc@0 {
			compatible = "anlogic,dragon_remoteproc";
			memory-region = <&rproc_0_reserved>, <&vdev0vring0>, <&vdev0vring1>, <&vdev0buffer>;
			/*anlogic,no-openamp;*/
		};
	};
```

## Documentation/devicetree/bindings/reset/reset-anlogic.txt
```
Anlogic Reset Manager

The Anlogic has several different resets.

Required properties:
- compatible: "anlogic,reset-controller"
- #reset-cells: Must be 1
- reset-gpios: gpio pin for reset
- reset-delays: reset delay times
- reset-post-delays: reset delay post times

Example:
	reset: reset-controller {
		compatible = "anlogic,reset-controller";
		#reset-cells = <1>;
		reset-gpios = <&porta 7 GPIO_ACTIVE_LOW>, <&porta 8 GPIO_ACTIVE_LOW>;
		reset-delays = <10>, <10>;
		reset-post-delays = <0>, <100>;
	};

Reset outputs:
 0  : usb reset
 1  : gbe reset
```
