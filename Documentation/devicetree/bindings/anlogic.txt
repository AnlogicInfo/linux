## Documentation/devicetree/bindings/anlogic.txt
```
   a) Anlogic IP AXI-UART core

	(name): (generic-name)@(base-address) {
		compatible = "anlogic,(ip-core-name)-(HW_VER)"
			     [, (list of compatible devices), ...];
		reg = <(baseaddr) (size)>;
		interrupt-parent = <&interrupt-controller-phandle>;
		interrupts = < ... >;
		anlogic,(parameter1) = "(string-value)";
		anlogic,(parameter2) = <(int-value)>;
	};

	(generic-name):   an open firmware-style name that describes the
			generic class of device.  Preferably, this is one word, such
			as 'serial' or 'ethernet'.
	(ip-core-name):	the name of the ip block (given after the BEGIN
			directive in system.mhs).  Should be in lowercase
			and all underscores '_' converted to dashes '-'.
	(name):		is derived from the "PARAMETER INSTANCE" value.
	(parameter#):	C_* parameters from system.mhs.  The C_ prefix is
			dropped from the parameter name, the name is converted
			to lowercase and all underscore '_' characters are
			converted to dashes '-'.
	(baseaddr):	the baseaddr parameter value (often named C_BASEADDR).
	(HW_VER):	from the HW_VER parameter.
	(size):		the address range size (often C_HIGHADDR - C_BASEADDR + 1).

   Typically, the compatible list will include the exact IP core version
   followed by an older IP core version which implements the same
   interface or any other device with the same interface.

   'reg' and 'interrupts' are all optional properties.

   For example, the following block from system.mhs:

	BEGIN xps_uartlite
		PARAMETER INSTANCE = xps_uartlite_0
		PARAMETER HW_VER = 1.00.a
		PARAMETER C_BAUDRATE = 115200
		PARAMETER C_DATA_BITS = 8
		PARAMETER C_ODD_PARITY = 0
		PARAMETER C_USE_PARITY = 0
		PARAMETER C_CLK_FREQ = 50000000
		BUS_INTERFACE SOPB = xps_7
		PORT OPB_Clk = CLK_50MHz
		PORT Interrupt = xps_uartlite_0_Interrupt
		PORT RX = xps_uartlite_0_RX
		PORT TX = xps_uartlite_0_TX
		PORT XPS_Rst = sys_bus_reset_0
	END

   becomes the following device tree node:

	xps_uartlite_0: serial@A0000000 {
		device_type = "serial";
		compatible = "anlogic,xps-uartlite-1.00.a";
		reg = <0x0 0xA0000000 0x0 0x1000>;
		interrupts = <GIC_SPI 82 IRQ_TYPE_LEVEL_HIGH>;
		current-speed = <d#115200>;	// standard serial device prop
		clock-frequency = <d#50000000>;	// standard serial device prop
		anlogic,data-bits = <8>;
		anlogic,odd-parity = <0>;
		anlogic,use-parity = <0>;
	};

	b) Anlogic IP AXI-GPIO core

	axi_gpio: gpio@80000000 {
		compatible = "anlogic,axi-gpio-1.00.a";
		reg = <0x0 0x80000000 0x0 0x10000>;
		interrupts = <GIC_SPI 82 IRQ_TYPE_LEVEL_HIGH>;
		#gpio-cells = <2>;
		#interrupt-cells = <0x2>;
		clock-frequency = <50000000>;
		gpio-controller;
		anlogic,all-inputs = <0x0>;
		anlogic,all-inputs-2 = <0x0>;
		anlogic,all-outputs = <0x0>;
		anlogic,all-outputs-2 = <0x0>;
		anlogic,dout-default = <0x0>;
		anlogic,dout-default-2 = <0x0>;
		anlogic,gpio-width = <0x20>;
		anlogic,gpio2-width = <0x20>;
		anlogic,interrupt-present = <0x1>;
		anlogic,is-dual = <0x1>;
		anlogic,tri-default = <0xFFFFFFFF>;
		anlogic,tri-default-2 = <0xFFFFFFFF>;
	};

	axi_gpio-keys {
		compatible = "gpio-keys";
		#address-cells = <0x1>;
		#size-cells = <0x0>;
		axi_sw5: axi_sw5 {
			gpios = <&axi_gpio 0 GPIO_ACTIVE_LOW>;
			linux,code = <103>; /* KEY_UP */
			status = "okay";
		};
	};
```

## Documentation/devicetree/bindings/clock/anlogic,dr1x90-crp.txt
```
* Anlogic CRP

The Anlogic CRP generates and supplies clock to various controllers within the SoC.
The clock binding described here is applicable to dr1x90 SoC's.

Required Properties:

- compatible: should be one of the following,
	"anlogic,dr1x90-crp"
- reg: physical base address of the controller and length of memory mapped
  region.
- clocks: Reference to the parent clocks
- #clock-cells: should be 1.
- #reset-cells: should be 1.

Each clock is assigned an identifier, and client nodes can use this identifier
to specify the clock which they consume.

All available clocks are defined as preprocessor macros in corresponding
dt-bindings/clock/anl_dr1x90_crp.h header and can be used in device tree sources.

External clocks:

The cryst_osc clock used as input for the plls is generated outside the SoC. It is
expected that it is defined using standard clock bindings as "cryst_osc".

Example: Clock Management Unit node:

	crp: crp@f8801000 {
		compatible = "anlogic,dr1x90-crp";
		reg = <0x0 0xf8801000 0 0x0400>;
		clocks = <&cryst_osc>;
		clock-names = "cryst_osc";
		#clock-cells = <1>;
		#reset-cells = <1>;
		status = "okay";
	};

Example: serial controller node that consumes clock generated by the clock
management unit:

	&serial0 {
		clocks = <&crp CLK_UART>, <&crp CLK_APB>;
		clock-names = "baudclk", "apb_pclk";
	};
```

## Documentation/devicetree/bindings/display/anlogic/anlogic,dynclk.yaml
```yaml
# SPDX-License-Identifier: (GPL-2.0-only OR BSD-2-Clause)
%YAML 1.2
---
$id: http://devicetree.org/schemas/display/anlogic/anlogic,dynclk.yaml#
$schema: http://devicetree.org/meta-schemas/core.yaml#

title: Anlogic dynamic clock

description: |
  AXI PLL IP can dynamic generate different frequency clock. Dynclk driver should
  work with AXI PLL IP.

maintainers:
  - Guanghao.zhang <guanghao.zhang@anlogic.com>

properties:
  compatible:
    const: anlogic,dynclk

  reg:
    maxItems: 1
  reg-names:
    items:
      - const: base address

required:
  - compatible
  - reg
  - refclk
  - expclk

additionalProperties: false

examples:
  - |
    axi_dynclk@80300000 {
        compatible = "anlogic,dynclk";
        reg = <0x0 0x80300000 0x0 0x10000>;
        refclk = <50000000>;
        expclk = <40000000>;
    };
...
```

## Documentation/devicetree/bindings/display/anlogic/anlogic,vdmafb.yaml
```yaml
# SPDX-License-Identifier: (GPL-2.0-only OR BSD-2-Clause)
%YAML 1.2
---
$id: http://devicetree.org/schemas/display/anlogic/anlogic,vdmafb.yaml#
$schema: http://devicetree.org/meta-schemas/core.yaml#

title: Anlogic framebuffer driver

description: |
  Anlogic vdma framebuffer driver. Should work with vdma, vtc and dynclk.

maintainers:
  - Guanghao.zhang <guanghao.zhang@anlogic.com>

properties:
  compatible:
    const: anlogic,vdmafb

  reg:
    maxItems: 1
  reg-names:
    items:
      - const: base address

  dmas:
    items:
      - description: Video output

  dma-names:
    items:
      - const: vdma

required:
  - compatible
  - reg
  - dmas
  - dma-names
  - pixel-format
  - display-timings

additionalProperties: false

examples:
  - |
    vdmafb@80400000 {
        compatible = "anlogic,vdmafb";
        reg = <0x0 0x80400000 0x0 0x10000>;
        dmas = <&axi_vdma 0>;
        dma-names = "vdma";
        pixel-format = "RGB888";
        display-timings {
            native-mode = <&timing_800x600>;
            timing_800x480: timing0 {
                clock-frequency = <25000000>;
                hactive = <800>;
                vactive = <480>;
                hback-porch = <30>;
                hfront-porch = <80>;
                hsync-len = <10>;
                vback-porch = <10>;
                vfront-porch = <25>;
                vsync-len = <5>;
                hsync-active = <0>;
                vsync-active = <0>;
                de-active = <1>;
                pixelclk-active = <0>;
            };
            timing_1920x1080: timing1 {
                clock-frequency = <150000000>;
                hactive = <1920>;
                vactive = <1080>;
                hback-porch = <280>;
                hfront-porch = <88>;
                hsync-len = <44>;
                vback-porch = <35>;
                vfront-porch = <4>;
                vsync-len = <5>;
                hsync-active = <0>;
                vsync-active = <0>;
                de-active = <1>;
                pixelclk-active = <0>;
            };
            timing_1280x720: timing2 {
                clock-frequency = <75000000>;
                hactive = <1280>;
                vactive = <720>;
                hback-porch = <220>;
                hfront-porch = <110>;
                hsync-len = <40>;
                vback-porch = <20>;
                vfront-porch = <5>;
                vsync-len = <5>;
                hsync-active = <0>;
                vsync-active = <0>;
                de-active = <1>;
                pixelclk-active = <0>;
            };
            timing_800x600: timing3 {
                clock-frequency = <40000000>;
                hactive = <800>;
                vactive = <600>;
                hback-porch = <88>;
                hfront-porch = <40>;
                hsync-len = <128>;
                vback-porch = <23>;
                vfront-porch = <1>;
                vsync-len = <4>;
                hsync-active = <0>;
                vsync-active = <0>;
                de-active = <1>;
                pixelclk-active = <0>;
            };
        };
    };
...
```

## Documentation/devicetree/bindings/dma/anlogic/anlogic_dma.txt
```
Anlogic AXI DMA engine, it does transfers between memory and AXI4 stream
target devices. It can be configured to have one channel or two channels.
If configured as two channels, one is to transmit to the device and another
is to receive from the device.

Required properties:
- compatible: Should be one of-
		"anlogic,axi-dma"
		"anlogic,axi-vdma"
- #dma-cells: Should be <1>, see "dmas" property below
- reg: Should contain DMA registers location and length.
- anlogic,addrwidth: Should be the vdma addressing size in bits(ex: 32 bits).
- dma-channel child node: Should have at least one channel and can have up to
	two channels per device. This node specifies the properties of each
	DMA channel (see child node properties below).

Required properties for VDMA:
- anlogic,num-fstores: Should be the number of framebuffers as configured in h/w.

Optional properties for AXI DMA:
- anlogic,sg-length-width: Should be set to the width in bits of the length
	register as configured in h/w. Takes values {8...26}. If the property
	is missing or invalid then the default value 23 is used. This is the
	maximum value that is supported by all IP versions.
Optional properties for VDMA:
- anlogic,flush-fsync: Tells which channel to Flush on Frame sync.
	It takes following values:
	{1}, flush both channels
	{2}, flush mm2s channel
	{3}, flush s2mm channel

Required child node properties:
- compatible:
	For AXIDMA: It should be either "anlogic,axi-dma-mm2s-channel"
	or "anlogic,axi-dma-s2mm-channel".
	For VDMA: It should be either "anlogic,axi-vdma-mm2s-channel" or
	"anlogic,axi-vdma-s2mm-channel".
- interrupts: Should contain per channel DMA interrupts.
- anlogic,datawidth: Should contain the stream data width, take values
	{32,64...1024}.

Optional child node properties:
- anlogic,include-dre: Tells hardware is configured for Data
	Realignment Engine.
Optional child node properties for VDMA:
- anlogic,genlock-mode: Tells Genlock synchronization is
	enabled/disabled in hardware.
- anlogic,enable-vert-flip: Tells vertical flip is
	enabled/disabled in hardware(S2MM path).


Example:
++++++++

axi_dma: axidma@80000000 {
	#dma-cells = <1>;
	compatible = "anlogic,axi-dma";
	interrupt-parent = <&gic>;
	interrupts = <GIC_SPI 83 IRQ_TYPE_LEVEL_HIGH>,
			<GIC_SPI 82 IRQ_TYPE_LEVEL_HIGH>;
	reg = <0x0 0x80000000 0x0 0x1000>;
	anlogic,addrwidth = <0x20>;
	anlogic,include-sg;
	dma-channel@80000000 {
		compatible = "anlogic,axi-dma-mm2s-channel";
		dma-channels = <0x1>;
		interrupts = <GIC_SPI 83 IRQ_TYPE_LEVEL_HIGH>;
		anlogic,datawidth = <0x20>;
		anlogic,include-dre;
	};
	dma-channel@80000030 {
		compatible = "anlogic,axi-dma-s2mm-channel";
		dma-channels = <0x1>;
		interrupts = <GIC_SPI 82 IRQ_TYPE_LEVEL_HIGH>;
		anlogic,datawidth = <0x20>;
		anlogic,include-dre;
	};
};

axi_vdma_0: axivdma@80002000 {
	compatible = "anlogic,axi-vdma";
	#dma-cells = <1>;
	reg = <0x0 0x80002000 0x0 0x10000 >;
	interrupt-parent = <&gic>;
	interrupts = <GIC_SPI 83 IRQ_TYPE_EDGE_RISING>, <GIC_SPI 82 IRQ_TYPE_EDGE_RISING>;
	anlogic,num-fstores = <0x5>;
	anlogic,flush-fsync = <0x1>;
	anlogic,addrwidth = <0x20>;
	dma-channel@80002000 {
		compatible = "anlogic,axi-vdma-mm2s-channel";
		interrupts = <GIC_SPI 83 IRQ_TYPE_EDGE_RISING>;
		anlogic,datawidth = <0x20>;
	} ;
	dma-channel@80002030 {
		compatible = "anlogic,axi-vdma-s2mm-channel";
		interrupts = <GIC_SPI 82 IRQ_TYPE_EDGE_RISING>;
		anlogic,datawidth = <0x20>;
	} ;
} ;
```

## Documentation/devicetree/bindings/dma/anlogic/axi-dma-test.txt
```
Anlogic AXI DMA Test Driver

This is a test driver for the Anlogic AXI DMA engine. This driver is used for
testing and demonstrative purposes.

Required properties:
- compatible: Should be "anlogic,axi-dma-test".
- dmas: List of DMA specifiers for the DMA channels.
- dma-names: Names of the DMA channels. Should be "axidma_mm2s" for the memory
	to stream channel, and "axidma_s2mm" for the stream to memory channel.


Example:
++++++++

axidmatest: axidmatest@1 {
	compatible = "anlogic,axi-dma-test";
	dmas = <&dma_example 0>,
	       <&dma_example 1>;
	dma-names = "axidma_mm2s", "axidma_s2mm";
};
```

## Documentation/devicetree/bindings/dma/anlogic/axi-vdma-test.txt
```
Anlogic AXI VDMA Test Driver

This is a test driver for the Anlogic AXI VDMA engine. This driver is used for
testing and demonstrative purposes.

Required properties:
- compatible: Should be "anlogic,axi-dma-test".
- dmas: a list of <[Video DMA device phandle] [Channel ID]> pairs,
	where Channel ID is '0' for write/tx and '1' for read/rx
	channel. For MCMDA, MM2S channel(write/tx) ID start from
	'0' and is in [0-15] range. S2MM channel(read/rx) ID start
	from '16' and is in [16-31] range. These channels ID are
	fixed irrespective of IP configuration.

- dma-names: a list of DMA channel names, one per "dmas" entry

Example:
++++++++

vdmatest_1: vdmatest@1 {
	compatible ="anlogic,axi-vdma-test";
	anlogic,num-fstores = <0x5>;
	dmas = <&axi_vdma_0 0
		&axi_vdma_0 1>;
	dma-names = "vdma0", "vdma1";
} ;
```
