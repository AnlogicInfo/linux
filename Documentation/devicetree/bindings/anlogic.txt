## Documentation/devicetree/bindings/spi/anlogic,axi-qspi.txt
```
Anlogic Devices AXI QSPI controller Device Tree Bindings. It can be configured
to Standard SPI, Dual SPI or Qual SPI.

Required properties:
- compatible: should be "anlogic-axi-qspi-controller"
- reg: spi/qspi controller memory mapped registers
- interrupts: Interrupt specifier for the controllers interrupt.

Optional subnodes:
	Subnodes are use to represent the SPI slave devices connected to the SPI
	master. They follow the generic SPI bindings as outlined in spi-bus.txt.

Example:

axi_qspi0: spi@80000000 {
	compatible = "anlogic-axi-qspi-controller";
	interrupts = <GIC_SPI 82 IRQ_TYPE_LEVEL_HIGH>;
	clock-frequency = <25000000>;
	reg = <0x0 0x80000000 0 0x10000>;
	#address-cells = <1>;
	#size-cells = <0>;
	status = "okay";
	al-sync-clk = <0>;
	al-spi-mem-addr-bits = <24>;
	al-axi4-type = <1>;
	al-xip-mode = <0>;
	al-xip-perf = <0>;
	al-fifo-depth = <256>;
	al-sck-ratio = <2>;
	al-num-ss-bits = <1>;
	al-num-trans-bits = <8>;
	al-spi-mode = <0>;
	al-spi-memory = <3>;

	/* SPI devices */
};
```

## Documentation/devicetree/bindings/thermal/anlogic,dr1x90_thermal.txt
```
* Anlogic tvs thermal

This binding describes thermal sensors that is part of Anlogic Dr1x SoCs.

Required properties:
- compatible : Must be "anlogic,dr1x90_thermal"
- reg : register range
- #thermal-sensor-cells : Thermal sensor phandler
- clocks: clocks of sensor xADC
- clock-names: clock names.

Example:
	pvt0: pvt@f8801404 {
		compatible = "anlogic,dr1x90_thermal";
		reg = <0 0xf8801404 0 0x4>;
		clocks = <&crp CLK_TVS>;
		clock-names = "tvsclk";
		#thermal-sensor-cells = <1>;
		status = "okay";
	};
```

## Documentation/devicetree/bindings/uio/anlogic,uio-gen.txt
```
Anlogic generic uio driver

This binding document describes the bindings for the Anlogic generic uio driver.

The Anlogic generic uio driver is kernel part driver for uio. It can be used
together with anlogic user space uio wrapper interfaces.

Required properties:
	- compatible: Should be "anlogic,uio-gen"
	- reg: Address and length of the register set for the device

Optional properties:
	- interrupts: Interrupt for this device.
	- al,uioname: The name of uio device. You can use this name
	  to open this uio device in user space.
	- al,dmem: A list of dma memory lengths which will be allocated
	  for this device. Each is 32bit.


Examples:
	testuio0: testuio@78000000 {
		compatible = "anlogic,uio-gen";
		reg = <0 0x78000000 0 0x1000>;
		al,uioname = "testuioname0";
		al,dmem = <0x2000 0x1000>;
		status = "okay";
	};
```

## drivers/clk/anlogic/Kconfig
```kconfig
# SPDX-License-Identifier: GPL-2.0-only
config ANLOGIC_CRP
	bool "Clock support for Anlogic Socs"
	depends on ANLOGIC_SOC || COMPILE_TEST
	select RESET_CONTROLLER
	default n
	help
	  Select this option if you want Anlogic Clock and Reset Supporing.

if ANLOGIC_CRP
config ANLOGIC_DR1X90_CRP
	tristate "Support for the Anlogic Dr1x90 crp"
	default n
endif
```

## drivers/jpu/Kconfig
```kconfig
# SPDX-License-Identifier: GPL-2.0-only
#
# jpu related drivers
#

menu "JPEG Processing Unit"

config JPU_ANLOGIC
    bool "jpu_anlogic"
    help
      This option enables the JPEG Processing Unit driver for JPEG Codec.
      The JPEG Processing Unit is used to accelerate JPEG encoding and decoding operations.
      Perform the JPEG baseline/extended sequential and M-JPEG encoding and decoding.

endmenu
```

## drivers/net/ethernet/anlogic/Kconfig
```kconfig
# SPDX-License-Identifier: GPL-2.0-only
#
# Anlogic device configuration
#

config ANLOGIC_ETHLITE
	tristate "Anlogic 10/100 Ethernet Lite support"

	help
	  This option enables support for the Anlogic 10/100 Ethernet Lite
	  controller. If you have a board with an Anlogic Ethernet Lite
	  controller, say Y or M here to include support for it in your
	  kernel. If unsure, say N.

	  To compile this driver as a module, choose M here. The module
	  will be called anlogic_ethlite.

	  This driver provides 10/100 Mbps Ethernet support and is suitable
	  for Anlogic FPSoC that feature the Ethernet Lite controller. It
	  supports both half-duplex and full-duplex modes, as well as a
	  variety of network protocols.
```

## drivers/npu/Kconfig
```kconfig
# SPDX-License-Identifier: GPL-2.0-only
#
# npu related drivers
#

menu "NPU Modules"

menuconfig NPU_MODULE
        bool "NPU related Modules"
        help
                This option enables the NPU related modules, including hard_npu_driver,
                soft_npu_driver and cma_mem_driver.

if NPU_MODULE

config HARD_NPU_DRIVER
        tristate "hard_npu_driver"
        help
                This option enables the NPU driver for hard NPU device. hard NPU device is
                used to accelerate conv and gemm operations.

config SOFT_NPU_DRIVER
        tristate "soft_npu_driver"
        help
                This option enables the NPU driver for soft NPU device. soft NPU device is
                used to accelerate operations except for conv and gemm.

config CMA_MEM_DRIVER
        tristate "cma_mem_driver"
        help
                This option enables the NPU driver for cma memory. hard NPU and soft NPU device
                exchange data through cma memory.

endif # NPU_MODULE

endmenu
```

## drivers/soc/anlogic/Kconfig
```kconfig
# SPDX-License-Identifier: GPL-2.0-only
menu "Anlogic SoC drivers"

config ANLOGIC_SOC
	bool "Anlogic SoC"
	select ARM_AMBA
	select SOC_BUS
	default n
	help
	  Say yes if need codes for Anlogic SoCs.

config ANLOGIC_TOP_CFG
	bool "Anlogic SoC Top Control"
	default y
	depends on ANLOGIC_SOC
	help
	  Say yes to enable Anlogic SoC Top control.

config ANLOGIC_TOP_USER_SACCESS
	bool "Anlogic SoC User Secure Access"
	default y
	depends on ANLOGIC_SOC && ANLOGIC_TOP_CFG && ARM64
	help
	  Say yes to enable accessing Anlogic SoC Top secure registers
	  from user space.

endmenu
```
