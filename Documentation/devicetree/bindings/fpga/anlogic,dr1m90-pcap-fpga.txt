## Documentation/devicetree/bindings/fpga/anlogic,dr1m90-pcap-fpga.txt
```
Fpga-mgr bindings

Required properties:
- compatible: should be "anlogic,dr1m90-pcap-fpga"
- reg: physical base address of the controller and length of memory mapped region.

description: |
  Device Tree Bindings for Anlogic Dr1m90.
  The Anlogic SoC uses the PCAP (Processor Configuration Port) to
  configure the Programmable Logic (PL). The configuration uses the
  firmware interface

Example:

	fpga: fpga-mgr@F8082000 {
		compatible = "anlogic,dr1m90-pcap-fpga";
		reg = <0x00 0xF8801000 0x00 0x1000>;
	};
```

## Documentation/devicetree/bindings/gpio/snps,dw-apb-anlogic-gpio.txt
```
Anlogic Design N-bit GPIO expander bindings

Required properties:
- compatible: should be "snps,dw-apb-anlogic-gpio"(gpio@f8411000 in example)
- compatible: should be "snps,dw-apb-gpio-port"(gpio-controller@0 in example)
- reg: Offset and length of the register set for the device
- reg: Max Ports
- clocks: DW GPIO debounce reference clock source
- interrupts: Interrupt specifier for the controllers interrupt.
- #gpio-cells: Should be 2. The first cell is the GPIO number and the
  second cell is used to specify optional parameters:
  - bit 0: polarity (0: normal, 1: inverted)
- gpio-controller: Marks the device as a GPIO controller.
- ngpios: The number of GPIO pins exported by the port.
- interrupts: The interrupts to the parent controller raised when GPIOs generate
              the interrupts. If the controller provides one combined interrupt
              for all GPIOs, specify a single interrupt. If the controller provides
              one interrupt for each GPIO, provide a list of interrupts that
              correspond to each of the GPIO pins.
- interrupt-controller : marks this as an interrupt controller

description: |
  Synopsys DesignWare GPIO controllers have a configurable number of ports,
  each of which are intended to be represented as child nodes with the generic
  GPIO-controller properties as desribed in this bindings file.

Example:

gpio: gpio@f8411000 {
	compatible = "snps,dw-apb-anlogic-gpio";
	interrupt-parent = <&gic>;
	reg = <0x0 0xf8411000 0x0 0x1000>;
	clocks = <&GPIO_CLK>;
	#address-cells = <1>;
	#size-cells = <0>;
	status = "okay";

	bank0: gpio-controller@0 {
		compatible = "snps,dw-apb-gpio-port";
		interrupts = <GIC_SPI 52 IRQ_TYPE_LEVEL_HIGH>;
		reg = <0>;
		ngpios = <32>;
		gpio-controller;
		#gpio-cells = <2>;
		interrupt-controller;
		#interrupt-cells = <2>;
	};
};
```

## Documentation/devicetree/bindings/hand_npu/anlogic,hard_npu.txt
```
Anlogic hard_npu  bindings

Required properties:
- compatible: should be "anlogic,hard_npu"
- reg: Offset and length of the register set for the device
- interrupts: Interrupt specifier for the controllers interrupt.

hardnpu: part of al neural processing unit implemented as hard IP;

Example:

hard_npu: hard_npu@63F00000 {
		compatible = "anlogic,hard_npu";
		reg = <0x0 0x63F00000 0x0 0x00100000>;
		interrupts = <0 112 0x04>;
};
```

## Documentation/devicetree/bindings/hdmi/adi,axi-hdmi-tx-1.00.a.txt
```
Anlogic hdmi  bindings

Required properties:
- compatible: should be "adi,axi-hdmi-tx-1.00.a"
- reg: Offset and length of the register set for the device
- clocks:clocks for this module
- dmas: DMA specifiers for tx and rx dma. See the DMA client binding
- dma-names: the corresponding channel name, must be "data"
- remote-endpoint: A phandle to the bus receiver's endpoint node.
Example:

axi_hdmi@80500000 {
	compatible = "adi,axi-hdmi-tx-1.00.a";
	reg = <0x0 0x80500000 0x0 0x10000>;
	dmas = <&soft_adi_dma 0>;
	dma-names = "video";
	clocks = <&axi_hdmi_clk>, <&axi_hdmi_clk>;
	status = "disabled";

	port {
		axi_hdmi_out: endpoint {
			remote-endpoint = <&adv7511_in>;
		};
	};
};
```

## Documentation/devicetree/bindings/iio/adc/anlogic,fpsoc-adc-1.00.a.txt
```
Anlogic adc  bindings

Required properties:
- compatible: should be "anlogic,fpsoc-adc-1.00.a"
- reg: Offset and length of the register set for the device(adc@f840b000 node in example)
- reg: Channel number(channel@0 node in example)
- interrupts: Interrupt specifier for the controllers interrupt.
- resolution: The resolution of an ADC (Analog-to-Digital Converter).
  refers to its ability to convert analog signals into digital signals with precision.
- iomux: Select the iomux corresponding to the channel for data processing.

ADC include a 12bit , 5 Mega sample per second(MSPS) Successive-Approximation ADC , having the resolution selectable between 12/10/8 and 6 bit. The ADC provide several operation modes include Single Channel Mode、Single Pass Mode、Continuous Sequence Mode、External Multiplexer Mode. The ADC also provide various analog input signal types, for example, unipolar and differential. The ADC can access up to 17 external analog input channels include 1x dedicated IO channel and 16x shared IO channels.

Example:
	adc: adc@f840b000 {
		compatible = "anlogic,fpsoc-adc-1.00.a";
		#address-cells = <2>;
		#size-cells = <2>;
		reg = <0x0 0xf840b000 0x0 0x20>;
		interrupts = <GIC_SPI 24 IRQ_TYPE_LEVEL_HIGH>;
		resolution = <12>;
		anlogic,channels {
			#address-cells = <1>;
			#size-cells = <0>;
			channel@0 {
				reg = <0>;
				iomux = <16>;
			};
		};
	};
```

## Documentation/devicetree/bindings/jpu/anlogic,jpu.txt
```
Anlogic jpu  bindings

Required properties:
- compatible: should be "anlogic,jpu"
- reg: Offset and length of the register set for the device
- interrupts: Interrupt specifier for the controllers interrupt.

JPU: JPEG processing unit.

Example:
jpu: jpu@f8460000 {
		compatible = "anlogic,jpu";
		reg = <0x0 0xF8460000 0x0 0x00010000>;
		interrupts = <0 113 0x04>;
	};
```

## Documentation/devicetree/bindings/net/anlogic,ethernetlite1.0.txt
```
Anlogic  Design ethernet expander bindings

Required properties:
- compatible: should be "anlogic,ethernetlite1.0"
- reg: Offset and length of the register set for the device.
- interrupts: Interrupt specifier for the controllers interrupt.
- device_type: set to "network".(ethernet@1C0000000 node in example)
- device_type: set to "xxxphy".(phy@1 node in example)
- local-mac-address: MAC address assigned to this device
- phy-handle: Reference to a PHY node connected to this device


The Anlogic  Ethernet Subsystem implements a tri-mode (10/100 Mb/s) Ethernet MAC or a 10/100 Mb/s Ethernet MAC. This core supports the use of MII, RGMII, and 100BASE-X interfaces to connect a media access control (MAC) to a Physical-side interface (PHY) chip.

Example:
	axi_ethernetlite_1: ethernet@1C0000000 {
		compatible = "anlogic,ethernetlite1.0";
		device_type = "network";
		interrupt-parent = <&gic>;
		interrupts = <GIC_SPI 82 IRQ_TYPE_LEVEL_HIGH>;
		local-mac-address = [E0 78 A3 00 00 05];
		phy-handle = <&pl_eth_phy0>;
		reg = <0x1 0xC0000000 0x0 0x10000>;
		mdio {
			#address-cells = <1>;
			#size-cells = <0>;
			pl_eth_phy0: phy@1 {
					device_type = "ethernet-phy";
					reg = <1>;
			} ;
		};
	};
```

## Documentation/devicetree/bindings/net/can/ipms,canfd.txt
```
Anlogic can  bindings

Required properties:
- compatible: should be "ipms,canfd"
- reg: physical base address of the controller and length of memory mapped region.
- interrupts: Interrupt specifier for the controllers interrupt.


Example:

	ipmscan0: can@0xF8408000 {
		compatible = "ipms,canfd";
		reg = <0x0 0xF8408000 0x0 0x1000>;
		interrupt-parent = <&plic0>;
		interrupts = <73>;

	};
```

## Documentation/devicetree/bindings/serial/anlogic,xps-uartlite.yaml
```yaml
# SPDX-License-Identifier: GPL-2.0 OR BSD-2-Clause
%YAML 1.2
---
$id: http://devicetree.org/schemas/serial/anlogic,opb-uartlite.yaml#
$schema: http://devicetree.org/meta-schemas/core.yaml#

title: Anlogic Axi Uartlite

properties:
  compatible:
    contains:
      enum:
        - anlogic,xps-uartlite-1.00.a

  reg:
    maxItems: 1

  interrupts:
    maxItems: 1

  port-number:
    $ref: /schemas/types.yaml#/definitions/uint32
    description: Set Uart port number

  clocks:
    maxItems: 1

  clock-names:
    const: s_axi_aclk

  current-speed:
    $ref: /schemas/types.yaml#/definitions/uint32
    description:
      The fixed baud rate that the device was configured for.

  anlogic,data-bits:
    enum: [5, 6, 7, 8]
    description:
      The fixed number of data bits that the device was configured for.

  anlogic,use-parity:
    $ref: /schemas/types.yaml#/definitions/uint32
    enum: [0, 1]
    description:
      Whether parity checking was enabled when the device was configured.

  anlogic,odd-parity:
    $ref: /schemas/types.yaml#/definitions/uint32
    enum: [0, 1]
    description:
      Whether odd parity was configured.

required:
  - compatible
  - reg
  - interrupts
  - current-speed
  - anlogic,data-bits
  - anlogic,use-parity

allOf:
  - $ref: /schemas/serial.yaml#
  - if:
      properties:
        anlogic,use-parity:
          contains:
            const: 1
    then:
      required:
        - anlogic,odd-parity

unevaluatedProperties: false

examples:
  - |
      serial@A0000000 {
        compatible = "anlogic,xps-uartlite-1.00.a";
        reg = <0x0 0xA0000000 0x0 0x1000>;
        interrupts = <GIC_SPI 82 IRQ_TYPE_LEVEL_HIGH>;
        port-number = <0>;
        current-speed = <115200>;
        anlogic,data-bits = <8>;
        anlogic,use-parity = <0>;
      };
...
```

## Documentation/devicetree/bindings/soft_npu/anlogic,soft_npu.txt
```
Anlogic soft_npu  bindings

Required properties:
- compatible: should be "anlogic,soft_npu"
- reg: Offset and length of the register set for the device
- interrupts: Interrupt specifier for the controllers interrupt.

softnpu: part of al neural processing unit implemented as soft IP which is extensiblel;

Example:

soft_npu: soft_npu@91000000 {
	compatible = "anlogic,soft_npu";
	reg = <0x0 0x91000000 0x0 0x00100000>;
	interrupts = <0 97 0x04>;
};
```

## Documentation/devicetree/bindings/spi/anlogic,dr1x90-qspi.txt
```
Spi bindings

Required properties:
- compatible: should be "anlogic,dr1x90-qspi"
- reg: spi/qspi controller memory mapped registers
- interrupts: Interrupt specifier for the controllers interrupt.
- clocks: Controller reference clock source
- rx-sample-delay : Default value of the rx-sample-delay-ns property.
      This value will be used if the property is not explicitly defined
      for a SPI slave device.

Optional properties:
- num-cs: Number of chip selects used.

anlogic Synchronous Serial Interfac

Example:

	qspi: spi@f804e000 {
		#address-cells = <1>;
		#size-cells = <0>;
		compatible = "anlogic,dr1x90-qspi";
		reg = <0xf804e000 0x1000>;
		interrupts = <GIC_SPI 48 IRQ_TYPE_LEVEL_HIGH>;
		clocks = <&qspi_m_clk>;
		rx-sample-delay = <0>;
		num-cs = <1>;
		status = "okay";
	};
```

## Documentation/devicetree/bindings/spi/rohm,dh2228fv.txt
```
Anlogic spi  bindings

Required properties:
- compatible: should be "rohm,dh2228fv"
- reg: reg device address.
- spi-max-frequency: Maximum SPI clocking speed of device in Hz

Rohm, dh2228fv is a digital humidity sensor produced by Rohm Electronics. It is a sensor device used to measure humidity in the air, commonly used in various electronic devices and environmental monitoring systems. In Linux systems, device matching properties are typically used to identify and configure device drivers to ensure that devices can communicate correctly with the operating system.

Example:
	spidev@0 {
		compatible = "rohm,dh2228fv";
		reg = <0>;
		spi-max-frequency = <8000000>;
	};
```

## Documentation/devicetree/bindings/watchdog/anlogic,dw-wdt.txt
```
Anlogic Synopsys Designware Watchdog Timer

Required properties:
- compatible: should be "anlogic,dw-wdt"
- reg: Two registers need to be configured, the first is the position
       offset and length of the watchdog controller, and the second is the
       position offset and length of the top controller.
- interrupts: DW Watchdog pre-timeout interrupt.
- clocks: Watchdog timer reference clock.

DW APB Watchdog custom timer intervals - Timeout Period ranges (TOPs).
Each TOP is a number loaded into the watchdog counter at the moment of
the timer restart. The counter decrementing happens each tick of the
reference clock. Therefore the TOPs array is equivalent to an array of
the timer expiration intervals supported by the DW APB Watchdog. Note
DW APB Watchdog IP-core might be synthesized with fixed TOP values,
in which case this property is unnecessary with default TOPs utilized.

Example:

watchdog0:watchdog@f8410000 {
	compatible = "anlogic,dw-wdt";
	#address-cells = <2>;
	#size-cells = <2>;
	reg = <0x0 0xf8410000 0x0 0x100 0x0 0Xf8800168 0x0 0x20>;
	interrupts = <GIC_SPI 26 IRQ_TYPE_LEVEL_HIGH>;
	clocks = <&WDT_CLK>;
	status = "disabled";
};
```
